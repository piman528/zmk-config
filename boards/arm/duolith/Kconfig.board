## boards/arm/duolith/Kconfig.board
```kconfig
config BOARD_DUOLITH_LEFT
    bool "duolith left"
    depends on SOC_NRF52840_QIAA

config BOARD_DUOLITH_RIGHT
    bool "duolith right"
    depends on SOC_NRF52840_QIAA
```

## boards/shields/duolith/Kconfig.defconfig
```kconfig
if SHIELD_DUOLITH_RIGHT

config PMW3610
    default y

config INPUT
    default y

config SPI
    default y

endif # SHIELD_DUOLITH_RIGHT

if SHIELD_DUOLITH_LEFT

config ZMK_KEYBOARD_NAME
    default "duolith"

config ZMK_SPLIT_ROLE_CENTRAL
    default y

endif # SHIELD_DUOLITH_LEFT

if SHIELD_DUOLITH_LEFT || SHIELD_DUOLITH_RIGHT

config ZMK_POINTING
    default y

config ZMK_SPLIT
    default y

endif # SHIELD_DUOLITH_LEFT || SHIELD_DUOLITH_RIGHT
```

## boards/shields/duolith/Kconfig.shield
```kconfig
config SHIELD_DUOLITH_LEFT
    def_bool $(shields_list_contains,duolith_left)

config SHIELD_DUOLITH_RIGHT
    def_bool $(shields_list_contains,duolith_right)
```
